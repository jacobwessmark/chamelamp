## main/Kconfig.projbuild
```kconfig
menu "Chamelamp Configuration"

    choice DEVICE_MODE
        prompt "Device Mode"
        default DEVICE_MODE_SENDER
        help
            Select device operating mode.

        config DEVICE_MODE_SENDER
            bool "Sender (Color Sensor + LED Rings)"
            help
                Configure as sender device with TCS34725 color sensor and LED rings.

        config DEVICE_MODE_RECEIVER
            bool "Receiver (LCD Display)"
            help
                Configure as receiver device with LCD display.
    endchoice

    config WIFI_SSID
        string "WiFi SSID"
        default "my_ap_ssid"
        help
            Set the SSID of the WiFi network.

    config WIFI_PASS
        string "WiFi Password"
        default "my_ap_password"
        help
            Set the password of the WiFi network.

endmenu
```
